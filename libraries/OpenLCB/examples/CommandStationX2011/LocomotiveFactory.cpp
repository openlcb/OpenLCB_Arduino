#include "LocomotiveFactory.h"
#include "OLCB_CAN_Link.h"

//This is where we watch to see if a new request for a locomotive is likely to occur, and create an
//instance of the Locomotive class to service it. We check by watching for verifyNID messages, which
//will be generated by nodes that need to discover the alias of a given NID. Since locomotive NIDs
//are well-known, we can take advantage of this mechanism to instantiate Locomotive instances
//just-in-time.
//Notice that this method will only ever be called if no other existing Locomotive instance
//already has.
bool LocomotiveFactory::verifyNID(OLCB_NodeID *nid)
{
  if( (nid->val[0] == 6) && (nid->val[1] == 1) ) //if it's intended for a DCC locomotive
  {
    //Serial.println("Producing a new virtual node for address: ");
//    nid->print();
    //find a slot for it
    for(int i = 0; i < NUM_SLOTS; ++i)
    {
      if(_locos[i].isAvailable()) //an empty slot is found!
      {
        //Serial.print("    Installing in slot ");
        //Serial.println(i,DEC);
        _locos[i].setLink(_link);
        _locos[i].setNID(nid);
        _locos[i].verified = false; //just in case
        return false; //what the what? we're actually not yet ready to send out the verifiedNID packet, as we don't yet have an alias.
        //That's up to the virtual node to do on its own!
      }
    }
    //Serial.println("    Out of slots. Too bad."); //TODO Need to figure out what to do in this case?
    //It won't do to let the throttle requesting the loco just hang, we need to tell it something informative.
    //Problem is, without enough memory, we can't request an alias to go with the requested NID, and so
    //we can't respond /as/ the loco being queried. Need a mechanism for telling a throttle about this?
    //We could use the LocoFactory's alias, then pass it a datagram to inform it of why it's request
    //is invalid, and then send out a message indicating that the alias is being invalidated for that NID.
  }
  return false; //no room availble, or not a request for a loco. (see above)
}

void LocomotiveFactory::update(void)
{
  //This is where we should force a verifiedID from any recently created loco, as it would have missed
  // the initial request.
  for(int i = 0; i < NUM_SLOTS; ++i)
  {
    if(!_locos[i].verified && _locos[i].NID->alias) //"verified" is just a flag to let us know that it hasn't verified its
    // NID yet; checking alias ensures that it has been assigned one. In this case, we need to tell the node to
    // send out a verified ID message.
    {
      //Serial.println("Sending VerifedNID");
      ((OLCB_CAN_Link*)_link)->sendVerifiedNID(_locos[i].NID);
      _locos[i].verified = true;
    }
  }
}
